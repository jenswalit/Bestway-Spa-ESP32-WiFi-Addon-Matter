## firmware/main/Kconfig.projbuild
```kconfig
menu "Bestway Spa Control v5"

config BESTWAY_SIMULATION
    bool "Bestway pump simulation mode"
    default y
    help
        Enable a software simulated Bestway pump. This allows Matter and later
        web/MQTT integration to be tested without a physical spa connected.
        Disable only when the native CIO/DSP hardware transport is available.

endmenu
```

## firmware/sdkconfig.defaults
```kconfig
CONFIG_IDF_TARGET="esp32c6"
CONFIG_BT_ENABLED=y
CONFIG_BT_NIMBLE_ENABLED=y
CONFIG_ENABLE_CHIPOBLE=y
CONFIG_USE_BLE_ONLY_FOR_COMMISSIONING=y
CONFIG_ENABLE_WIFI_STATION=y
CONFIG_ENABLE_ESP32_DEVICE_INSTANCE_INFO_PROVIDER=y
CONFIG_SUPPORT_BRIDGED_DEVICE_BASIC_INFORMATION_CLUSTER=y
CONFIG_ESP_MATTER_MAX_DYNAMIC_ENDPOINT_COUNT=12
CONFIG_ESP_MATTER_MAX_DEVICE_TYPE_COUNT=4
CONFIG_ESP_MATTER_BRIDGE_INFO_PART_NAME="bridge_info"
CONFIG_ESP_MATTER_NVS_USE_COMPACT_ATTR_STORAGE=y
CONFIG_MBEDTLS_HKDF_C=y
CONFIG_ESPTOOLPY_FLASHSIZE_8MB=y
CONFIG_ESPTOOLPY_FLASHSIZE="8MB"
CONFIG_PARTITION_TABLE_CUSTOM=y
CONFIG_PARTITION_TABLE_CUSTOM_FILENAME="partitions.csv"
CONFIG_LOG_DEFAULT_LEVEL_INFO=y
CONFIG_LOG_MAXIMUM_LEVEL_INFO=y
CONFIG_BESTWAY_SIMULATION=y

CONFIG_CUSTOM_DEVICE_INSTANCE_INFO_PROVIDER=y

# Native ESP-IDF WebSocket voor live spa-bediening
CONFIG_HTTPD_WS_SUPPORT=y

# CONFIG_ENABLE_TEST_SETUP_PARAMS is not set

# CONFIG_EXAMPLE_COMMISSIONABLE_DATA_PROVIDER is not set

CONFIG_CUSTOM_COMMISSIONABLE_DATA_PROVIDER=y

# CONFIG_TEST_EVENT_TRIGGER_ENABLED is not set
```
